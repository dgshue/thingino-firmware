## configs/cameras/night_owl_t23n_jxf37p_aic8800d/night_owl_t23n_jxf37p_aic8800d_defconfig
```kconfig
# NAME: Night Owl (T23N, GC2083, AIC8800 USB)
# MODULE: t23n_jxf37p_aic8800d
BR2_PACKAGE_THINGINO_KOPT_MMC0=y
BR2_PACKAGE_THINGINO_KOPT_MMC0_PB_4BIT=y
BR2_THINGINO_AUDIO=y
BR2_THINGINO_BUTTON=y
BR2_THINGINO_PWM_ENABLE=y
BR2_THINGINO_SDCARD=y
BR2_PACKAGE_WIFI_AIC8800=y
BR2_PACKAGE_WIFI_AIC8800_USB=y
BR2_PACKAGE_WIFI_AIC8800_USB_8800DC=y
BR2_SOC_INGENIC_T23N=y
# NB! needs larger flash size due to WiFi firmware
FLASH_SIZE_16=y
BR2_PACKAGE_LIBGPIOD=y
BR2_PACKAGE_LIBGPIOD_TOOLS=y
```
